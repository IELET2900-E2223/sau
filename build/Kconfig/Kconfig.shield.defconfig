## build/Kconfig/Kconfig.shield.defconfig
```kconfig
osource "c:/Users/tjodm/Documents/GitHub/nrf/modem_shell/boards/shields/*/Kconfig.defconfig"
osource "C:/Users/tjodm/ncs/v1.9.1/nrf/boards/shields/*/Kconfig.defconfig"
```
