## CMakeLists.txt
```
#
# Copyright (c) 2019 Nordic Semiconductor
#
# SPDX-License-Identifier: LicenseRef-Nordic-5-Clause
#

cmake_minimum_required(VERSION 3.20.0)

find_package(Zephyr REQUIRED HINTS $ENV{ZEPHYR_BASE})
project(SAU)

zephyr_library_sources(src/main.c)

zephyr_library_sources_ifdef(CONFIG_SAU_ASSISTANCE_NRF_CLOUD src/assistance.c)
zephyr_library_sources_ifdef(CONFIG_SAU_ASSISTANCE_SUPL src/assistance_supl.c)
zephyr_library_sources_ifdef(CONFIG_SAU_ASSISTANCE_MINIMAL src/assistance_minimal.c)
zephyr_library_sources_ifdef(CONFIG_SAU_ASSISTANCE_MINIMAL src/mcc_location_table.c)
```

## Kconfig
```
#
# Copyright (c) 2020 Nordic Semiconductor ASA
#
# SPDX-License-Identifier: LicenseRef-Nordic-5-Clause
#

menu "Antenna configs"

# Chose which antenna to use; onboard or external
# This affect if we configure the LNA ( READ ABOUT MAGPIO AND COEX0 )
choice
	default SAU_ANTENNA_ONBOARD
	prompt "Select which antenna to use for GNSS"

config SAU_ANTENNA_ONBOARD
	bool "Use onboard antenna"

config SAU_ANTENNA_EXTERNAL
	bool "Use external antenna"

endchoice

config SAU_AT_MAGPIO
	string "AT%XMAGPIO command"
	default "AT\%XMAGPIO=1,0,0,1,1,1574,1577" if BOARD_NRF9160DK_NRF9160_NS
	default "AT\%XMAGPIO=1,1,1,7,1,746,803,2,698,748,2,1710,2200,3,824,894,4,880,960,5,791,849,7,1565,1586" if BOARD_THINGY91_NRF9160_NS
	help
	  Defines the AT%XMAGPIO command to be sent to GNSS module. Leave
	  empty if this command should not be sent.

config SAU_AT_COEX0
	string "AT%XCOEX0 command"
	default "AT\%XCOEX0=1,1,1565,1586" if (BOARD_NRF9160DK_NRF9160_NS || BOARD_THINGY91_NRF9160_NS) && SAU_ANTENNA_ONBOARD
	default "AT\%XCOEX0" if (BOARD_NRF9160DK_NRF9160_NS || BOARD_THINGY91_NRF9160_NS) && SAU_ANTENNA_EXTERNAL
	help
	  Defines the AT%XCOEX0 command to be sent to GNSS module. Leave
	  empty if this command should not be sent.

endmenu

choice
	default SAU_ASSISTANCE_NONE
	prompt "Select whether GNSS assistance is used or not"

config SAU_ASSISTANCE_NONE
	bool "Assistance not used"

config SAU_ASSISTANCE_NRF_CLOUD
	bool "Use nRF Cloud A-GPS or P-GPS"
	select NRF_CLOUD_REST
	imply NRF_CLOUD_AGPS
	select MODEM_JWT
	select MODEM_INFO
	select DATE_TIME
endchoice

#		PGS-GREIER
# if !SAU_ASSISTANCE_NONE
#config NRF_CLOUD_PGPS
#	prompt "Select whether PGPS assistance is used or not"
	#config NRF_CLOUD_PGPS
#endif #SAU_ASSISTANCE_NONE

if !SAU_ASSISTANCE_NONE

config SAU_LTE_ON_DEMAND
	bool "LTE is activated only when needed to fetch A-GPS data"
	depends on !NRF_CLOUD_PGPS
	help
	  Activates LTE only when it is needed to fetch A-GPS data. This is not supported when
	  P-GPS is enabled.

endif # !SAU_ASSISTANCE_NONE

config SAU_LOW_ACCURACY
	bool "Allow low accuracy fixes"
	help
	  Allows fixes with lower accuracy.

# This allows for lox accuracy fixes (using only 3 satelites). A fix must have been obtained before accepting a low accuray fix.
if SAU_LOW_ACCURACY

config SAU_ASSISTANCE_REFERENCE_ALT
	int "Reference altitude for 3-sat first fix in meters"
	range -32767 32767
	default -32767
	help
	  Reference altitude for 3-sat first fix in meters above the reference ellipsoid surface.
	  The default value -32767 implies that reference altitude is not injected.

endif #  SAU_LOW_ACCURACY


config CLOUD_BACKEND
	string "Selects the cloud backend to be used"
	default "NRF_CLOUD"
	help
	  Possible values are "NRF_CLOUD", "AWS_IOT", "AZURE_IOT_HUB".

config CLOUD_MESSAGE
	string "Sets the custom message published periodically to cloud"
	default "{\"state\":{\"reported\":{\"message\":\"Hello Internet of Things!\"}}}"

config CLOUD_CONNECTION_RETRY_TIMEOUT_SECONDS
	int "Sets the number of seconds between each cloud connection retry"
	default 30






#Something could go here







menu "Zephyr Kernel"
source "Kconfig.zephyr"
endmenu

module = SAU
module-str = GNSS sample
source "${ZEPHYR_BASE}/subsys/logging/Kconfig.template.log_config"
```

## sample.yaml
```
sample:
  name: SAU
tests:
  samples.nrf9160.cloud_client:
    build_only: true
    platform_allow: nrf9160dk_nrf9160_ns thingy91_nrf9160_ns
    integration_platforms:
      - nrf9160dk_nrf9160_ns
      - thingy91_nrf9160_ns
    tags: ci_build
```

## prj.conf
```kconfig
#
# Copyright (c) 2019 Nordic Semiconductor ASA
#
# SPDX-License-Identifier: LicenseRef-Nordic-5-Clause
#

# General
CONFIG_FPU=y
CONFIG_NRF_MODEM_LIB=y
CONFIG_STDOUT_CONSOLE=y
CONFIG_UART_INTERRUPT_DRIVEN=y
CONFIG_NEWLIB_LIBC=y
CONFIG_NEWLIB_LIBC_FLOAT_PRINTF=y
CONFIG_LOG=y
CONFIG_LOG_MODE_IMMEDIATE=y

# SAU
# Enable to use an external GNSS antenna
CONFIG_SAU_ANTENNA_EXTERNAL=n
# Enable to use nRF Cloud A-GPS

# P-GPS
#CONFIG_NRF_CLOUD_PGPS=y
#CONFIG_NRF_CLOUD_PGPS_REPLACEMENT_THRESHOLD=4
#CONFIG_NRF_CLOUD_PGPS_PREDICTION_PERIOD = 60
# CONFIG_NRF_CLOUD_PGPS_NUM_PREDICTIONS #Using default of one week
# CONFIG_NRF_CLOUD_PGPS_DOWNLOAD_FRAGMENT_SIZE #Using default
#CONFIG_NRF_CLOUD_PGPS_REQUEST_UPON_INIT = n #n is default. kept for readability.

# Storage for P-GPS
CONFIG_STREAM_FLASH=y
CONFIG_FLASH=y
CONFIG_FLASH_PAGE_LAYOUT=y
CONFIG_FLASH_MAP=y
CONFIG_FCB=y
CONFIG_SETTINGS=y
CONFIG_SETTINGS_FCB=y
CONFIG_MPU_ALLOW_FLASH_WRITE=y

# Generic cloud API
CONFIG_CLOUD_API=y

# Selected cloud backend
CONFIG_CLOUD_BACKEND="NRF_CLOUD"

# nRF Cloud
CONFIG_NRF_CLOUD_MQTT=y

# MQTT
CONFIG_MQTT_KEEPALIVE=1200

# LTE Link Control
CONFIG_LTE_LINK_CONTROL=y
CONFIG_LTE_NETWORK_MODE_LTE_M_GPS=y
# CONFIG_LTE_NETWORK_MODE_NBIOT_GPS #Alternative
# CONFIG_LTE_NETWORK_MODE_LTE_M_NBIOT_GPS #Alternative
# Request eDRX from the network
CONFIG_LTE_EDRX_REQ=y
# PSM requested periodic TAU 8 hours
CONFIG_LTE_PSM_REQ_RPTAU="00101000"
# PSM requested active time 6 seconds
CONFIG_LTE_PSM_REQ_RAT="00000011"
# Auto-connect should be left off as we want the application to control LTE
CONFIG_LTE_AUTO_INIT_AND_CONNECT=n

# Networking
CONFIG_NETWORKING=y
CONFIG_NET_SOCKETS_OFFLOAD=y
CONFIG_NET_SOCKETS=y
CONFIG_NET_SOCKETS_POSIX_NAMES=y
CONFIG_NET_SOCKETS_SOCKOPT_TLS=y
# Disable native network stack to save some memory
CONFIG_NET_NATIVE=n

# Memory and stack configuration
# cloud and pgps required more stack
CONFIG_HEAP_MEM_POOL_SIZE=8192
CONFIG_MAIN_STACK_SIZE=4096
CONFIG_SYSTEM_WORKQUEUE_STACK_SIZE=2048


# CJSON
CONFIG_CJSON_LIB=y
CONFIG_SAU_AT_MAGPIO="AT%XMAGPIO=1,0,0,1,1,1574,1577"
CONFIG_SAU_AT_COEX0="AT%XCOEX0=1,1,1565,1586"



# Download client library stack size needs to be increased with P-GPS
#CONFIG_DOWNLOAD_CLIENT_STACK_SIZE=1280
```

## src/main.c
```c
/*
 * Copyright (c) 2022 Circuit Dojo LLC
 *
 * SPDX-License-Identifier: Apache-2.0
 */

#include <zephyr.h>
#include <modem/lte_lc.h>
#include <net/cloud.h>
#include <string.h>
#include <logging/log.h>
#include <nrf_modem_at.h>
#include <nrf_modem_gnss.h>
#include <date_time.h>
#include <net/cloud.h>
#include <net/socket.h>
#include <stdio.h>
#include <string.h>

#include "cJSON.h"
#include "assistance.h"

// Initiates log module. you can then chose which type of log event you want to see (warning, error, info)
LOG_MODULE_REGISTER(SAU, CONFIG_SAU_LOG_LEVEL);

// AGPS related
#if !defined(CONFIG_SAU_ASSISTANCE_NONE)
static struct k_work_q gnss_work_q;
// Allocates stack and priority
#define GNSS_WORKQ_THREAD_STACK_SIZE 2304
#define GNSS_WORKQ_THREAD_PRIORITY 5

K_THREAD_STACK_DEFINE(gnss_workq_stack_area, GNSS_WORKQ_THREAD_STACK_SIZE);

// agps related variables and threads
static struct nrf_modem_gnss_agps_data_frame last_agps; // For agps data
static struct k_work agps_data_get_work;				// function fot getting data
static volatile bool requesting_assistance;

/* requests agps data if needed*/
static void agps_data_get_work_fn(struct k_work *item)
{
	ARG_UNUSED(item);

	int err;

	requesting_assistance = true;

	printk("Assistance data needed, ephe 0x%08x, alm 0x%08x, flags 0x%02x",
		   last_agps.sv_mask_ephe,
		   last_agps.sv_mask_alm,
		   last_agps.data_flags);

// Following is only if LTE is disconnected between communication
#if defined(CONFIG_SAU_LTE_ON_DEMAND)
	lte_connect();
#endif /* CONFIG_SAU_LTE_ON_DEMAND */

	err = assistance_request(&last_agps);
	if (err)
	{
		printk("Failed to request assistance data\n");
	}

// Following is only if LTE is disconnected between communication (Its not in our application. LTE PSM FTW.)
#if defined(CONFIG_SAU_LTE_ON_DEMAND)
	lte_disconnect();
#endif /* CONFIG_SAU_LTE_ON_DEMAND */

	requesting_assistance = false;
}

#endif //! defined(CONFIG_SAU_ASSISTANCE_NONE)

// Cloud related variables
static struct cloud_backend *cloud_backend;
// static struct k_work_delayable cloud_update_work;
static struct k_work_delayable connect_work;

// Unused, but really cool. Might use in a future version
// static const char update_indicator[] = {'\\', '|', '/', '-'};

// For fix data
static struct nrf_modem_gnss_pvt_data_frame last_pvt;

bool cloud_connected; // Flags if we are connected to the cloud. Used for error handling.

static K_SEM_DEFINE(pvt_data_sem, 0, 1);  // This flags pvt data without a fix
static K_SEM_DEFINE(pvt_fix_sem, 0, 1);	  // This flags pvt data with a fix
static K_SEM_DEFINE(lte_connected, 0, 1); // This flags a successful connection

#define PVT_FIX_SEM 0
#define PVT_DATA_SEM 1

static struct k_poll_event events[2] = {

	K_POLL_EVENT_STATIC_INITIALIZER(K_POLL_TYPE_SEM_AVAILABLE,
									K_POLL_MODE_NOTIFY_ONLY,
									&pvt_fix_sem, 0),
	K_POLL_EVENT_STATIC_INITIALIZER(K_POLL_TYPE_SEM_AVAILABLE,
									K_POLL_MODE_NOTIFY_ONLY,
									&pvt_data_sem, 0),
};

struct cloud_data
{
	int developer;
	int fix_retry;
	int fix_interval;
	double lat_max;
	double lat_min;
	double lon_max;
	double lon_min;
};

struct json
{
	double longitude;
	double latitude;
	float altitude;
	float accuracy;
	int developer;
};

struct json package;
struct cloud_data from_cloud;

/* Thread for connecting to the cloud. Will always retry if unsuccessful */
static void connect_work_fn(struct k_work *work)
{
	int err;

	if (cloud_connected)
	{
		return;
	}

	err = cloud_connect(cloud_backend);
	if (err)
	{
		printk("cloud_connect error: %d", err);
	}

	printk("Next connection retry in %d seconds",
		   CONFIG_CLOUD_CONNECTION_RETRY_TIMEOUT_SECONDS);

	k_work_schedule(&connect_work, K_SECONDS(CONFIG_CLOUD_CONNECTION_RETRY_TIMEOUT_SECONDS));
}

/* Unused thread for sending stuff to the cloud. Kept for reference. */
/*
static void cloud_update_work_fn(struct k_work *work)
{
	int err;

	if (!cloud_connected)
	{
		printk("Not connected to cloud, abort cloud publication\n");
		return;
	}

	struct cloud_msg msg = {
		.qos = CLOUD_QOS_AT_MOST_ONCE,
		.buf = CONFIG_CLOUD_MESSAGE,
		.len = strlen(CONFIG_CLOUD_MESSAGE)};
*/
/* When using the nRF Cloud backend data is sent to the message topic.
 * This is in order to visualize the data in the web UI terminal.
 * For Azure IoT Hub and AWS IoT, messages are addressed directly to the
 * device twin (Azure) or device shadow (AWS).
 */
/*
if (strcmp(CONFIG_CLOUD_BACKEND, "NRF_CLOUD\n") == 0)
{
	msg.endpoint.type = CLOUD_EP_MSG;
}
else
{
	msg.endpoint.type = CLOUD_EP_STATE;
}

err = cloud_send(cloud_backend, &msg);
if (err)
{
	printk("cloud_send failed, error: %d", err);
}
}
*/
// Cloud event handler

/* This function analyzes a string sent from the cloud. Its used to changing interval, retry time or enabling developer mode. */
int cloud_message_parser(char *json_from_cloud)
{

	const cJSON *var = NULL;

	cJSON *json = cJSON_Parse(json_from_cloud);
	if (json == NULL)
	{
		printk("empty JSON string in json_parser()");
	}

	var = cJSON_GetObjectItemCaseSensitive(json, "Developer");
	if (cJSON_IsString(var))
	{ // Add wanted functionality when it receives developer update from cloud
		from_cloud.developer = atoi(var->valuestring);
		printk("Developer mode changed to %d", from_cloud.developer);
	}

	var = cJSON_GetObjectItemCaseSensitive(json, "fix_rates");
	if (cJSON_IsString(var))
	{ // Add wanted functionality when it receives fix_rates update from cloud
		from_cloud.fix_retry = atoi(var->valuestring);
		nrf_modem_gnss_fix_retry_set(atoi(var->valuestring));
	}

	var = cJSON_GetObjectItemCaseSensitive(json, "fix_interval");
	if (cJSON_IsString(var))
	{ // Add wanted functionality when it receives fix_interval update from cloud
		from_cloud.fix_interval = atoi(var->valuestring);
		nrf_modem_gnss_fix_interval_set(atoi(var->valuestring));
	}

	var = cJSON_GetObjectItemCaseSensitive(json, "lat_max");
	if (cJSON_IsString(var))
	{ // Add wanted functionality when it receives fix_interval update from cloud
		from_cloud.lat_max = atoi(var->valuestring);
	}
	var = cJSON_GetObjectItemCaseSensitive(json, "lat_min");
	if (cJSON_IsString(var))
	{ // Add wanted functionality when it receives fix_interval update from cloud
		from_cloud.lat_min = atoi(var->valuestring);
	}
	var = cJSON_GetObjectItemCaseSensitive(json, "lon_max");
	if (cJSON_IsString(var))
	{ // Add wanted functionality when it receives fix_interval update from cloud
		from_cloud.lon_max = atoi(var->valuestring);
	}
	var = cJSON_GetObjectItemCaseSensitive(json, "lon_min");
	if (cJSON_IsString(var))
	{ // Add wanted functionality when it receives fix_interval update from cloud
		from_cloud.lon_min = atoi(var->valuestring);
	}

	// printk("Developer from cloud parsed json: %d \n", output);
	cJSON_Delete(json);

	return 1;
}

/* 	This function is used for checking if the sheep is inside a fixed geofence.
	If its still inside, we won't have to send the data.
	Meant for future expansions.	*/
bool in_geofence()
{
	if (package.latitude < from_cloud.lat_max &&
		package.latitude > from_cloud.lat_min &&
		package.longitude < from_cloud.lon_max &&
		package.longitude > from_cloud.lon_min)
	{
		return true;
	}
	else
	{
		return false;
	}
}

/* Handler for cloud based events. Used to flag if we are connected, and reconnect if connection is lost. */
void cloud_event_handler(const struct cloud_backend *const backend,
						 const struct cloud_event *const evt,
						 void *user_data)
{
	ARG_UNUSED(user_data);
	ARG_UNUSED(backend);

	switch (evt->type)
	{
	case CLOUD_EVT_CONNECTING:
		printk("CLOUD_EVT_CONNECTING\n");
		break;
	case CLOUD_EVT_CONNECTED:
		printk("CLOUD_EVT_CONNECTED\n");
		cloud_connected = true;
		/* This may fail if the work item is already being processed,
		 * but in such case, the next time the work handler is executed,
		 * it will exit after checking the above flag and the work will
		 * not be scheduled again.
		 */
		(void)k_work_cancel_delayable(&connect_work);
		break;
	case CLOUD_EVT_READY:
		printk("CLOUD_EVT_READY\n");

		break;
	case CLOUD_EVT_DISCONNECTED:
		printk("CLOUD_EVT_DISCONNECTED\n");
		cloud_connected = false;
		k_work_reschedule(&connect_work, K_NO_WAIT);
		break;
	case CLOUD_EVT_ERROR:
		printk("CLOUD_EVT_ERROR\n");
		break;
	case CLOUD_EVT_DATA_SENT:
		printk("CLOUD_EVT_DATA_SENT\n");
		break;
	case CLOUD_EVT_DATA_RECEIVED:

		printk("CLOUD_EVT_DATA_RECEIVED\n");
		printk("Data received from cloud: %.*s",
			   evt->data.msg.len,
			   log_strdup(evt->data.msg.buf));
		cloud_message_parser(evt->data.msg.buf); // This cloud message parser does the magic! Acts on given keyword from the cloud.
		break;

	case CLOUD_EVT_PAIR_REQUEST:
		printk("CLOUD_EVT_PAIR_REQUEST\n");
		break;
	case CLOUD_EVT_PAIR_DONE:
		printk("CLOUD_EVT_PAIR_DONE\n");
		break;
	case CLOUD_EVT_FOTA_DONE:
		printk("CLOUD_EVT_FOTA_DONE\n");
		break;
	case CLOUD_EVT_FOTA_ERROR:
		printk("CLOUD_EVT_FOTA_ERROR\n");
		break;
	default:
		printk("Unknown cloud event type: %d", evt->type);
		break;
	}
}

static void work_init(void)
{
	// k_work_init_delayable(&cloud_update_work, cloud_update_work_fn); //Kept for reference
	k_work_init_delayable(&connect_work, connect_work_fn);
}

// GNSS related
/* Handler for modem errors. HOPEFULLY never used */
void nrf_modem_recoverable_error_handler(uint32_t error)
{
	printk("Modem library recoverable error: %u", error);
}

/* GNSS event handler. Flags new pvt-data and valid pvt-data. */
static void gnss_event_handler(int event)
{
	int retval;

	switch (event)
	{
	case NRF_MODEM_GNSS_EVT_PVT:
		retval = nrf_modem_gnss_read(&last_pvt, sizeof(last_pvt), NRF_MODEM_GNSS_DATA_PVT);

		if (retval == 0)
		{
			k_sem_give(&pvt_data_sem);
		}
		break;

	case NRF_MODEM_GNSS_EVT_FIX:

		retval = nrf_modem_gnss_read(&last_pvt, sizeof(last_pvt), NRF_MODEM_GNSS_DATA_PVT);

		if (retval == 0)
		{
			k_sem_give(&pvt_fix_sem); // This flags K_POLL_STATE_SEM_AVAILABLE
		}
		break;
	case NRF_MODEM_GNSS_EVT_NMEA:
		// We chose to not use this, but kept it for future reference.
		/* nmea_data = k_malloc(sizeof(struct nrf_modem_gnss_nmea_data_frame));
		if (nmea_data == NULL)
		{
			printk("Failed to allocate memory for NMEA\n");
			break;
		}

		retval = nrf_modem_gnss_read(nmea_data,
									 sizeof(struct nrf_modem_gnss_nmea_data_frame),
									 NRF_MODEM_GNSS_DATA_NMEA);
		if (retval == 0)
		{
			retval = k_msgq_put(&nmea_queue, &nmea_data, K_NO_WAIT);
			// printk("nmea data was put in nmea queue \n");
		}

		if (retval != 0)
		{
			k_free(nmea_data);
			// printk("nmea data was freed \n");
		}
		*/
		break;

	case NRF_MODEM_GNSS_EVT_AGPS_REQ:
		// case for handling AGPS requests. This case is called when the modem needs a-gps data. We chose to handle it or ignore it based on the konfig.
#if !defined(CONFIG_SAU_ASSISTANCE_NONE)
		retval = nrf_modem_gnss_read(&last_agps,
									 sizeof(last_agps),
									 NRF_MODEM_GNSS_DATA_AGPS_REQ);
		if (retval == 0)
		{
			printk("agps_data_get_work submitted to gnss_work_q\n");
			k_work_submit_to_queue(&gnss_work_q, &agps_data_get_work);
		}
#endif // !CONFIG_SAU_ASSISTANCE_NONE
		break;
	default:
		break;
	}
}
/*  LTE Event handler. This is only used for info when testing. Its not needed in the final product. */
static void lte_handler(const struct lte_lc_evt *const evt)
{
	switch (evt->type)
	{
	case LTE_LC_EVT_NW_REG_STATUS:
		if ((evt->nw_reg_status != LTE_LC_NW_REG_REGISTERED_HOME) &&
			(evt->nw_reg_status != LTE_LC_NW_REG_REGISTERED_ROAMING))
		{
			break;
		}

		printk("Network registration status: %s",
			   evt->nw_reg_status == LTE_LC_NW_REG_REGISTERED_HOME ? "Connected - home network" : "Connected - roaming\n");
		break;
	case LTE_LC_EVT_PSM_UPDATE:
		printk("PSM parameter update: TAU: %d, Active time: %d",
			   evt->psm_cfg.tau, evt->psm_cfg.active_time);
		break;
	case LTE_LC_EVT_EDRX_UPDATE:
	{
		char log_buf[60];
		ssize_t len;

		len = snprintf(log_buf, sizeof(log_buf),
					   "eDRX parameter update: eDRX: %f, PTW: %f",
					   evt->edrx_cfg.edrx, evt->edrx_cfg.ptw);
		if (len > 0)
		{
			printk("%s", log_strdup(log_buf));
		}
		break;
	}
	case LTE_LC_EVT_RRC_UPDATE:
		printk("RRC mode: %s",
			   evt->rrc_mode == LTE_LC_RRC_MODE_CONNECTED ? "Connected" : "Idle\n");
		break;
	case LTE_LC_EVT_CELL_UPDATE:
		printk("LTE cell changed: Cell ID: %d, Tracking area: %d",
			   evt->cell.id, evt->cell.tac);
		break;
	case LTE_LC_EVT_LTE_MODE_UPDATE:
		printk("Active LTE mode changed: %s",
			   evt->lte_mode == LTE_LC_LTE_MODE_NONE ? "None" : evt->lte_mode == LTE_LC_LTE_MODE_LTEM ? "LTE-M"
															: evt->lte_mode == LTE_LC_LTE_MODE_NBIOT  ? "NB-IoT"
																									  : "Unknown\n");
		break;
	case LTE_LC_EVT_MODEM_EVENT:
		printk("Modem domain event, type: %s",
			   evt->modem_evt == LTE_LC_MODEM_EVT_LIGHT_SEARCH_DONE ? "Light search done" : evt->modem_evt == LTE_LC_MODEM_EVT_SEARCH_DONE ? "Search done"
																						: evt->modem_evt == LTE_LC_MODEM_EVT_RESET_LOOP	   ? "Reset loop detected"
																						: evt->modem_evt == LTE_LC_MODEM_EVT_BATTERY_LOW   ? "Low battery"
																						: evt->modem_evt == LTE_LC_MODEM_EVT_OVERHEATED	   ? "Modem is overheated"
																																		   : "Unknown\n");
		break;
	default:
		break;
	}
}

/* Connects to LTE, sets mode,*/
static int modem_init(void)
{
	// Configures the antenna and LNA
	if (strlen(CONFIG_SAU_AT_MAGPIO) > 0)
	{
		if (nrf_modem_at_printf("%s", CONFIG_SAU_AT_MAGPIO) != 0)
		{
			printk("Failed to set MAGPIO configuration\n");
			return -1;
		}
	}
	// Configures the antenna and LNA
	if (strlen(CONFIG_SAU_AT_COEX0) > 0)
	{
		if (nrf_modem_at_printf("%s", CONFIG_SAU_AT_COEX0) != 0)
		{
			printk("Failed to set COEX0 configuration\n");
			return -1;
		}
	}

	int err = lte_lc_modem_events_enable();
	if (err)
	{
		LOG_ERR("lte_lc_modem_events_enable failed, error: %d",
				err);
		return 0;
	}

	lte_lc_init_and_connect_async(lte_handler);

	lte_lc_psm_req(true);	   // Requesting LTM PSM
	if (lte_lc_connect() != 0) // The actual connection
	{
		printk("Failed to connect to LTE network\n");
		return -1;
	}
	printk("Connected to LTE network, psm true \n");

	printk("Modem init done \n");
	return 0;
}

/* Initiates the work queue for the assistance module*/
static int sample_init(void)
{

	int err = 0;
#if !defined(CONFIG_SAU_ASSISTANCE_NONE) // This only happens if we want to use AGPS
	struct k_work_queue_config cfg = {
		.name = "gnss_work_q",
		.no_yield = false};

	k_work_queue_start(
		&gnss_work_q,
		gnss_workq_stack_area,
		K_THREAD_STACK_SIZEOF(gnss_workq_stack_area),
		GNSS_WORKQ_THREAD_PRIORITY,
		&cfg);
	printk("work_queue_start done \n");
	k_work_init(&agps_data_get_work, agps_data_get_work_fn);

	err = assistance_init(&gnss_work_q);
	printk("Assistance init done \n");
#endif /* !CONFIG_SAU_ASSISTANCE_NONE */
	return err;
}

static int gnss_init_and_start(void)
{

	/* Configure GNSS. */
	if (nrf_modem_gnss_event_handler_set(gnss_event_handler) != 0)
	{
		printk("Failed to set GNSS event handler\n");
		return -1;
	}
	printk("Gnss handler set! \n");

	/* Enable all supported NMEA messages. */
	/* // We're not using the nmea masks, but kept if for future reference
	uint16_t nmea_mask = NRF_MODEM_GNSS_NMEA_RMC_MASK |
						 NRF_MODEM_GNSS_NMEA_GGA_MASK |
						 NRF_MODEM_GNSS_NMEA_GLL_MASK |
						 NRF_MODEM_GNSS_NMEA_GSA_MASK |
						 NRF_MODEM_GNSS_NMEA_GSV_MASK;

	if (nrf_modem_gnss_nmea_mask_set(nmea_mask) != 0)
	{
		printk("Failed to set GNSS NMEA mask\n");
		return -1;
	}
	printk("NMEA masks set \n");
*/

	/* This use case flag should always be set. */
	uint8_t use_case = NRF_MODEM_GNSS_USE_CASE_MULTIPLE_HOT_START;

	/*// We can save some data by setting this use case. However, we might be without a-gps data, which would cost more.
	  // This can be used if we have very long time between getting fixes.
		if (!IS_ENABLED(CONFIG_SAU_ASSISTANCE_NONE))
		{
			use_case |= NRF_MODEM_GNSS_USE_CASE_SCHED_DOWNLOAD_DISABLE;
		}
	*/

	if (IS_ENABLED(CONFIG_SAU_LOW_ACCURACY)) // Allows low accuracy fixes with only 3 satelites
	{
		use_case |= NRF_MODEM_GNSS_USE_CASE_LOW_ACCURACY;
	}

	if (nrf_modem_gnss_use_case_set(use_case) != 0)
	{
		printk("Failed to set GNSS use case\n");
	}
	else
	{
		printk("Use case set \n");
	}

	uint16_t fix_retry = 180;
	uint16_t fix_interval = 60 * 5;

	if (nrf_modem_gnss_fix_retry_set(fix_retry) != 0)
	{
		printk("Failed to set GNSS fix retry\n");
		return -1;
	}

	if (nrf_modem_gnss_fix_interval_set(fix_interval) != 0) // Would this make the modem get a new fix every fix_interval minutes
	{
		printk("Failed to set GNSS fix interval\n");
		return -1;
	}
	printk("Fix interval and retry set.");

	if (nrf_modem_gnss_start() != 0)
	{
		printk("Failed to start GNSS\n");
		return -1;
	}
	printk("gnss modem started! \n");

	return 0;
}

/* Prints satellite data; number of healthy satellites.*/
static void print_satellite_stats(struct nrf_modem_gnss_pvt_data_frame *pvt_data)
{
	uint8_t tracked = 0;
	uint8_t in_fix = 0;
	uint8_t unhealthy = 0;

	for (int i = 0; i < NRF_MODEM_GNSS_MAX_SATELLITES; ++i)
	{
		if (pvt_data->sv[i].sv > 0)
		{
			tracked++;
			if (pvt_data->sv[i].flags & NRF_MODEM_GNSS_SV_FLAG_USED_IN_FIX)
			{
				in_fix++;
			}
			if (pvt_data->sv[i].flags & NRF_MODEM_GNSS_SV_FLAG_UNHEALTHY)
			{
				unhealthy++;
			}
		}
	}

	printk("Tracking: %2d Using: %2d Unhealthy: %d \n", tracked, in_fix, unhealthy);
}

/* Prints location PVT data */
static void print_fix_data(struct nrf_modem_gnss_pvt_data_frame *pvt_data)
{
	printk("Latitude:       %.06f \n", pvt_data->latitude);
	printk("Longitude:      %.06f \n", pvt_data->longitude);
	printk("Altitude:       %.01f m \n", pvt_data->altitude);
	printk("Accuracy:       %.01f m \n", pvt_data->accuracy);
	printk("Speed:          %.01f m/s \n", pvt_data->speed);
	printk("Speed accuracy: %.01f m/s \n", pvt_data->speed_accuracy);
	printk("Heading:        %.01f deg \n", pvt_data->heading);
	printk("Date:           %04u-%02u-%02u \n",
		   pvt_data->datetime.year,
		   pvt_data->datetime.month,
		   pvt_data->datetime.day);
	printk("Time (UTC):     %02u:%02u:%02u.%03u \n",
		   pvt_data->datetime.hour,
		   pvt_data->datetime.minute,
		   pvt_data->datetime.seconds,
		   pvt_data->datetime.ms);
	printk("PDOP:           %.01f \n", pvt_data->pdop);
	printk("HDOP:           %.01f \n", pvt_data->hdop);
	printk("VDOP:           %.01f \n", pvt_data->vdop);
	printk("TDOP:           %.01f \n", pvt_data->tdop);
}

/* Function for transmitting message to the cloud*/
void transmit_to_cloud(char *message)
{
	struct cloud_msg msg = {
		.qos = CLOUD_QOS_AT_MOST_ONCE, // Bør evalueres
		.buf = message,
		.len = strlen(message)};

	int err = cloud_send(cloud_backend, &msg);
	if (err)
	{
		printk("cloud_send failed, error: %d", err);
	}
}

/* Function for converting the pvt data to our own package data */
void pvt_to_package(struct nrf_modem_gnss_pvt_data_frame *pvt_data)
{
	package.longitude = pvt_data->longitude;
	package.latitude = pvt_data->latitude;
	package.altitude = pvt_data->altitude;
	package.accuracy = pvt_data->accuracy;
}

/*  */
static void send_struct(struct json package)
{
	char *out;
	char lon_buf[128];
	char lat_buf[128];
	char alt_buf[128];
	char acc_buf[128];
	char dev_buf[128];
	double lon = package.longitude;
	double lat = package.latitude;
	float alt = package.altitude;
	float acc = package.accuracy;
	int dev = package.developer;

	snprintf(lon_buf, sizeof(lon_buf), "%.6f", lon);
	snprintf(lat_buf, sizeof(lat_buf), "%.6f", lat);
	snprintf(alt_buf, sizeof(alt_buf), "%.6f", alt);
	snprintf(acc_buf, sizeof(alt_buf), "%.6f", acc);
	snprintf(dev_buf, sizeof(alt_buf), "%d", dev);

	if (dev == 0)
	{
		printk("Latitude : %s\n", lon_buf);
		printk("Longitude: %s\n", lat_buf);
		printk("Altitude : %s\n", alt_buf);
		printk("DevMode  : %d\n", package.developer);
	}

	cJSON *root;

	// create root node and array
	root = cJSON_CreateObject();

	// add sensor data
	cJSON_AddItemToObject(root, "Latitude", cJSON_CreateString(lon_buf));
	cJSON_AddItemToObject(root, "Longitude", cJSON_CreateString(lat_buf));
	cJSON_AddItemToObject(root, "Altitude", cJSON_CreateString(alt_buf));
	cJSON_AddItemToObject(root, "Accuracy", cJSON_CreateString(acc_buf));
	cJSON_AddItemToObject(root, "Developer", cJSON_CreateString(dev_buf));

	// print everything
	out = cJSON_Print(root);
	if (out == NULL)
	{
		printk("Failed print...\n");
	}
	printk("%s\n", out);

	// CLOUD MAGIC

	transmit_to_cloud(out); // sender JSON til cloud

	// Publish with MQTT

	// data_publish(&client, MQTT_QOS_1_AT_LEAST_ONCE,
	// out, strlen(out));
	cJSON_free(out);
	free(out);

	// free all objects under root and root itself
	cJSON_Delete(root);

	return;
}

void checkForSem(void)
{
	k_poll(events, 2, K_FOREVER); // Looking at semaphores for gnss
	if (events[PVT_DATA_SEM].state == K_POLL_STATE_SEM_AVAILABLE &&
		k_sem_take(events[PVT_DATA_SEM].sem, K_NO_WAIT) == 0) // While searching for fix, this is called every second
	{
		// printk("\033[1;1H\n"); // These two lines clears the console between printing
		// printk("\033[2J\n");
		print_satellite_stats(&last_pvt); // Prints sat stats
	}
	// If there is new, valid PVT data:
	if (events[PVT_FIX_SEM].state == K_POLL_STATE_SEM_AVAILABLE &&
		k_sem_take(events[PVT_FIX_SEM].sem, K_NO_WAIT) == 0)
	{
		printk("Fix available!\n");
		print_fix_data(&last_pvt); // Prints the fix data
								   // if (events[CLOUD_CONNECTED_SEM].state == K_POLL_STATE_SEM_AVAILABLE && k_sem_take(events[CLOUD_CONNECTED_SEM].sem, K_NO_WAIT)) // Nested semchecks! Future is now.
		//{
		if (cloud_connected)
		{
			pvt_to_package(&last_pvt);
			send_struct(package);
			printk("Data sent!");
		}
		else
		{
			printk("Fix available, but we're not connected to the cloud");
		}
	}

	events[PVT_FIX_SEM].state = K_POLL_STATE_NOT_READY;
	events[PVT_DATA_SEM].state = K_POLL_STATE_NOT_READY;
}

void main(void)
{
	work_init(); // Cloud related work fn
	modem_init();
	sample_init(); // Assistance_init is called here
	gnss_init_and_start();

	cloud_backend = cloud_get_binding(CONFIG_CLOUD_BACKEND);
	__ASSERT(cloud_backend != NULL, "%s backend not found",
			 CONFIG_CLOUD_BACKEND);
	int err = cloud_init(cloud_backend, cloud_event_handler);
	if (err)
	{
		printk("Cloud backend could not be initialized, error: %d",
			   err);
	}
//	work_init(); //Why was this double? 

	k_work_schedule(&connect_work, K_NO_WAIT); // This thread connects to the cloud
	for (;;)
	{
		checkForSem(); // Polling function
	}
}
```

## src/assistance.c
```c
/*
 * Copyright (c) 2021 Nordic Semiconductor ASA
 *
 * SPDX-License-Identifier: LicenseRef-Nordic-5-Clause
 */

#include <stdlib.h>
#include <zephyr.h>
#include <logging/log.h>
#include <modem/modem_info.h>
#include <modem/modem_jwt.h>
#include <net/nrf_cloud_rest.h>
#if defined(CONFIG_NRF_CLOUD_AGPS)
#include <net/nrf_cloud_agps.h>
#endif /* CONFIG_NRF_CLOUD_AGPS */
#if defined(CONFIG_NRF_CLOUD_PGPS)
#include <pm_config.h>
#include <net/nrf_cloud_pgps.h>
#endif /* CONFIG_NRF_CLOUD_PGPS */

#include "assistance.h"

LOG_MODULE_DECLARE(SAU, CONFIG_SAU_LOG_LEVEL);

static char jwt_buf[600];
static char rx_buf[2048];

#if defined(CONFIG_NRF_CLOUD_AGPS)
static char agps_data_buf[3500];
#endif /* CONFIG_NRF_CLOUD_AGPS */

#if defined(CONFIG_NRF_CLOUD_PGPS)
static struct nrf_modem_gnss_agps_data_frame agps_need;
static struct gps_pgps_request pgps_request;
static struct nrf_cloud_pgps_prediction *prediction;
static struct k_work get_pgps_data_work;
static struct k_work inject_pgps_data_work;
#endif /* CONFIG_NRF_CLOUD_PGPS */

static struct k_work_q *work_q;
static volatile bool assistance_active;

#if defined(CONFIG_NRF_CLOUD_AGPS)
static int serving_cell_info_get(struct lte_lc_cell *serving_cell)
{
	int err;

	err = modem_info_init();
	if (err) {
		return err;
	}

	char resp_buf[MODEM_INFO_MAX_RESPONSE_SIZE];

	err = modem_info_string_get(MODEM_INFO_CELLID,
				    resp_buf,
				    MODEM_INFO_MAX_RESPONSE_SIZE);
	if (err < 0) {
		return err;
	}

	serving_cell->id = strtol(resp_buf, NULL, 16);

	err = modem_info_string_get(MODEM_INFO_AREA_CODE,
				    resp_buf,
				    MODEM_INFO_MAX_RESPONSE_SIZE);
	if (err < 0) {
		return err;
	}

	serving_cell->tac = strtol(resp_buf, NULL, 16);

	/* Request for MODEM_INFO_MNC returns both MNC and MCC in the same string. */
	err = modem_info_string_get(MODEM_INFO_OPERATOR,
				    resp_buf,
				    MODEM_INFO_MAX_RESPONSE_SIZE);
	if (err < 0) {
		return err;
	}

	serving_cell->mnc = strtol(&resp_buf[3], NULL, 10);
	/* Null-terminate MCC, read and store it. */
	resp_buf[3] = '\0';
	serving_cell->mcc = strtol(resp_buf, NULL, 10);

	return 0;
}
#endif /* CONFIG_NRF_CLOUD_AGPS */

#if defined(CONFIG_NRF_CLOUD_PGPS)
static void get_pgps_data_work_fn(struct k_work *work)
{
	ARG_UNUSED(work);

	int err;

	assistance_active = true;

	LOG_INF("Sending request for P-GPS predictions to nRF Cloud...");

	err = nrf_cloud_jwt_generate(0, jwt_buf, sizeof(jwt_buf));
	if (err) {
		LOG_ERR("Failed to generate JWT, error: %d", err);

		goto exit;
	}

	struct nrf_cloud_rest_context rest_ctx = {
		.connect_socket = -1,
		.keep_alive = false,
		.timeout_ms = NRF_CLOUD_REST_TIMEOUT_NONE,
		.auth = jwt_buf,
		.rx_buf = rx_buf,
		.rx_buf_len = sizeof(rx_buf),
		.fragment_size = 0, /* Defaults to CONFIG_NRF_CLOUD_REST_FRAGMENT_SIZE when 0 */
		.status = 0,
		.response = NULL,
		.response_len = 0,
		.total_response_len = 0
	};

	struct nrf_cloud_rest_pgps_request request = {
		.pgps_req = &pgps_request
	};

	err = nrf_cloud_rest_pgps_data_get(&rest_ctx, &request);
	if (err) {
		LOG_ERR("Failed to send P-GPS request, error: %d", err);

		nrf_cloud_pgps_request_reset();

		goto exit;
	}

	LOG_INF("Processing P-GPS response");

	err = nrf_cloud_pgps_process(rest_ctx.response, rest_ctx.response_len);
	if (err) {
		LOG_ERR("Failed to process P-GPS response, error: %d", err);

		nrf_cloud_pgps_request_reset();

		goto exit;
	}

	LOG_INF("P-GPS response processed");

exit:
	assistance_active = false;
}

static void inject_pgps_data_work_fn(struct k_work *work)
{
	ARG_UNUSED(work);

	int err;

	assistance_active = true;

	LOG_INF("Injecting P-GPS ephemerides");

	err = nrf_cloud_pgps_inject(prediction, &agps_need);
	if (err) {
		LOG_ERR("Failed to inject P-GPS ephemerides");
	}

	err = nrf_cloud_pgps_preemptive_updates();
	if (err) {
		LOG_ERR("Failed to request P-GPS updates");
	}

	assistance_active = false;
}

static void pgps_event_handler(struct nrf_cloud_pgps_event *event)
{
	switch (event->type) {
	case PGPS_EVT_AVAILABLE:
		prediction = event->prediction;

		k_work_submit_to_queue(work_q, &inject_pgps_data_work);
		break;

	case PGPS_EVT_REQUEST:
		memcpy(&pgps_request, event->request, sizeof(pgps_request));

		k_work_submit_to_queue(work_q, &get_pgps_data_work);
		break;

	case PGPS_EVT_LOADING:
		LOG_INF("Loading P-GPS predictions");
		assistance_active = true;
		break;

	case PGPS_EVT_READY:
		LOG_INF("P-GPS predictions ready");
		assistance_active = false;
		break;

	default:
		/* No action needed */
		break;
	}
}
#endif /* CONFIG_NRF_CLOUD_PGPS */

int assistance_init(struct k_work_q *assistance_work_q)
{
	work_q = assistance_work_q;

#if defined(CONFIG_NRF_CLOUD_PGPS)
	k_work_init(&get_pgps_data_work, get_pgps_data_work_fn);
	k_work_init(&inject_pgps_data_work, inject_pgps_data_work_fn);

	struct nrf_cloud_pgps_init_param pgps_param = {
		.event_handler = pgps_event_handler,
		.storage_base = PM_MCUBOOT_SECONDARY_ADDRESS,
		.storage_size = PM_MCUBOOT_SECONDARY_SIZE
	};

	if (nrf_cloud_pgps_init(&pgps_param) != 0) {
		LOG_ERR("Failed to initialize P-GPS");
		return -1;
	}
#endif /* CONFIG_NRF_CLOUD_PGPS */

	return 0;
}

int assistance_request(struct nrf_modem_gnss_agps_data_frame *agps_request)
{
	int err = 0;

#if defined(CONFIG_NRF_CLOUD_PGPS)
	/* Store the A-GPS data request for P-GPS use. */
	memcpy(&agps_need, agps_request, sizeof(agps_need));

#if defined(CONFIG_NRF_CLOUD_AGPS)
	if (!agps_request->data_flags) {
		/* No assistance needed from A-GPS, skip directly to P-GPS. */
		nrf_cloud_pgps_notify_prediction();
		return 0;
	}

	/* P-GPS will handle ephemerides, so skip those. */
	agps_request->sv_mask_ephe = 0;
	/* Almanacs are not needed with P-GPS, so skip those. */
	agps_request->sv_mask_alm = 0;
#endif /* CONFIG_NRF_CLOUD_AGPS */
#endif /* CONFIG_NRF_CLOUD_PGPS */
#if defined(CONFIG_NRF_CLOUD_AGPS)
	assistance_active = true;

	err = nrf_cloud_jwt_generate(0, jwt_buf, sizeof(jwt_buf));
	if (err) {
		LOG_ERR("Failed to generate JWT, error: %d", err);
		goto agps_exit;
	}

	struct nrf_cloud_rest_context rest_ctx = {
		.connect_socket = -1,
		.keep_alive = false,
		.timeout_ms = NRF_CLOUD_REST_TIMEOUT_NONE,
		.auth = jwt_buf,
		.rx_buf = rx_buf,
		.rx_buf_len = sizeof(rx_buf),
		.fragment_size = 0, /* Defaults to CONFIG_NRF_CLOUD_REST_FRAGMENT_SIZE when 0 */
		.status = 0,
		.response = NULL,
		.response_len = 0,
		.total_response_len = 0
	};

	struct nrf_cloud_rest_agps_request request = {
		.type = NRF_CLOUD_REST_AGPS_REQ_CUSTOM,
		.agps_req = agps_request,
		.net_info = NULL,
#if defined(CONFIG_NRF_CLOUD_AGPS_FILTERED_RUNTIME)
		.filtered = true,
		/* Note: if you change the mask angle here, you may want to
		 * also change it to match in gnss_init_and_start() in main.c.
		 */
		.mask_angle = CONFIG_NRF_CLOUD_AGPS_ELEVATION_MASK
		/* Note: if CONFIG_NRF_CLOUD_AGPS_FILTERED is enabled but
		 * CONFIG_NRF_CLOUD_AGPS_FILTERED_RUNTIME is not,
		 * the nrf_cloud_rest library will set the above fields to
		 * true and CONFIG_NRF_CLOUD_AGPS_ELEVATION_MASK respectively.
		 * When CONFIG_NRF_CLOUD_AGPS_FILTERED is disabled, it will
		 * set them to false and 0.
		 */
#endif
	};

	struct nrf_cloud_rest_agps_result result = {
		.buf = agps_data_buf,
		.buf_sz = sizeof(agps_data_buf),
		.agps_sz = 0
	};

	struct lte_lc_cells_info net_info = { 0 };

	err = serving_cell_info_get(&net_info.current_cell);
	if (err) {
		LOG_ERR("Could not get cell info, error: %d", err);
	} else {
		/* Network info for the location request. */
		request.net_info = &net_info;
	}

	LOG_INF("Requesting A-GPS data, ephe 0x%08x, alm 0x%08x, flags 0x%02x",
		agps_request->sv_mask_ephe,
		agps_request->sv_mask_alm,
		agps_request->data_flags);

	err = nrf_cloud_rest_agps_data_get(&rest_ctx, &request, &result);
	if (err) {
		LOG_ERR("Failed to get A-GPS data, error: %d", err);
		goto agps_exit;
	}

	LOG_INF("Processing A-GPS data");

	err = nrf_cloud_agps_process(result.buf, result.agps_sz);
	if (err) {
		LOG_ERR("Failed to process A-GPS data, error: %d", err);
		goto agps_exit;
	}

	LOG_INF("A-GPS data processed");

agps_exit:
	assistance_active = false;
#endif /* CONFIG_NRF_CLOUD_AGPS */

#if defined(CONFIG_NRF_CLOUD_PGPS)
	nrf_cloud_pgps_notify_prediction();
#endif /* CONFIG_NRF_CLOUD_PGPS */

	return err;
}

bool assistance_is_active(void)
{
	return assistance_active;
}
```

## src/assistance_minimal.c
```c
/*
 * Copyright (c) 2021 Nordic Semiconductor ASA
 *
 * SPDX-License-Identifier: LicenseRef-Nordic-5-Clause
 */

#include <stdio.h>
#include <stdlib.h>
#include <zephyr.h>
#include <sys/timeutil.h>
#include <settings/settings.h>
#include <logging/log.h>
#include <nrf_modem_at.h>
#include <nrf_modem_gnss.h>

#include "assistance.h"
#include "factory_almanac.h"
#include "mcc_location_table.h"

LOG_MODULE_DECLARE(sau, CONFIG_SAU_LOG_LEVEL);

/* (6.1.1980 UTC - 1.1.1970 UTC) */
#define GPS_TO_UNIX_UTC_OFFSET_SECONDS	(315964800UL)
/* UTC/GPS time offset as of 1st of January 2017. */
#define GPS_TO_UTC_LEAP_SECONDS		(18UL)
#define SEC_PER_MIN			(60UL)
#define MIN_PER_HOUR			(60UL)
#define SEC_PER_HOUR			(MIN_PER_HOUR * SEC_PER_MIN)
#define HOURS_PER_DAY			(24UL)
#define SEC_PER_DAY			(HOURS_PER_DAY * SEC_PER_HOUR)
#define DAYS_PER_WEEK			(7UL)
#define PLMN_STR_MAX_LEN		8 /* MCC + MNC + quotes */

static char almanac_checksum[64];

static int set(const char *key, size_t len_rd, settings_read_cb read_cb, void *cb_arg)
{
	int len;
	int key_len;
	const char *next;

	if (!key) {
		return -ENOENT;
	}

	key_len = settings_name_next(key, &next);

	if (!strncmp(key, "almanac_checksum", key_len)) {
		len = read_cb(cb_arg, &almanac_checksum, sizeof(almanac_checksum));
		if (len < sizeof(almanac_checksum)) {
			LOG_ERR("Failed to read almanac checksum from settings");
		}

		return 0;
	}

	return -ENOENT;
}

static struct settings_handler assistance_settings = {
	.name = "assistance",
	.h_set = set,
};

static void factory_almanac_write(void)
{
	int err;

	/* Check if the same almanac has already been written to prevent unnecessary writes
	 * to flash memory.
	 */
	if (!strncmp(almanac_checksum, FACTORY_ALMANAC_CHECKSUM, sizeof(almanac_checksum))) {
		LOG_INF("Factory almanac has already been written, skipping writing");
		return;
	}

	err = nrf_modem_at_printf("AT%%XFILEWRITE=1,\"%s\",\"%s\"",
				  FACTORY_ALMANAC, FACTORY_ALMANAC_CHECKSUM);
	if (err != 0) {
		LOG_ERR("Failed to write factory almanac");
		return;
	}

	LOG_INF("Wrote factory almanac");

	err = settings_save_one("assistance/almanac_checksum",
				FACTORY_ALMANAC_CHECKSUM,
				sizeof(almanac_checksum));
	if (err) {
		LOG_ERR("Failed to write almanac checksum to settings, error %d", err);
	}
}

static int64_t utc_to_gps_sec(const int64_t utc_sec)
{
	return (utc_sec - GPS_TO_UNIX_UTC_OFFSET_SECONDS) + GPS_TO_UTC_LEAP_SECONDS;
}

static void gps_sec_to_day_time(int64_t gps_sec,
				uint16_t *gps_day,
				uint32_t *gps_time_of_day)
{
	*gps_day = (uint16_t)(gps_sec / SEC_PER_DAY);
	*gps_time_of_day = (uint32_t)(gps_sec % SEC_PER_DAY);
}

static void time_inject(void)
{
	int ret;
	struct tm date_time;
	int64_t utc_sec;
	int64_t gps_sec;
	struct nrf_modem_gnss_agps_data_system_time_and_sv_tow gps_time = { 0 };

	/* Read current UTC time from the modem. */
	ret = nrf_modem_at_scanf("AT+CCLK?",
		"+CCLK: \"%u/%u/%u,%u:%u:%u",
		&date_time.tm_year,
		&date_time.tm_mon,
		&date_time.tm_mday,
		&date_time.tm_hour,
		&date_time.tm_min,
		&date_time.tm_sec
	);
	if (ret != 6) {
		LOG_WRN("Couldn't read current time from modem, time assistance unavailable");
		return;
	}

	/* Convert to struct tm format. */
	date_time.tm_year = date_time.tm_year + 2000 - 1900; /* years since 1900 */
	date_time.tm_mon--; /* months since January */

	/* Convert time to seconds since Unix time epoch (1.1.1970). */
	utc_sec = timeutil_timegm64(&date_time);
	/* Convert time to seconds since GPS time epoch (6.1.1980). */
	gps_sec = utc_to_gps_sec(utc_sec);

	gps_sec_to_day_time(gps_sec, &gps_time.date_day, &gps_time.time_full_s);

	ret = nrf_modem_gnss_agps_write(&gps_time, sizeof(gps_time),
					NRF_MODEM_GNSS_AGPS_GPS_SYSTEM_CLOCK_AND_TOWS);
	if (ret != 0) {
		LOG_ERR("Failed to inject time, error %d", ret);
		return;
	}

	LOG_INF("Injected time (GPS day %u, GPS time of day %u)",
		gps_time.date_day, gps_time.time_full_s);
}

static void location_inject(void)
{
	int err;
	char plmn_str[PLMN_STR_MAX_LEN + 1];
	uint16_t mcc;
	const struct mcc_table *mcc_info;
	struct nrf_modem_gnss_agps_data_location location = { 0 };

	/* Read PLMN string from modem to get the MCC. */
	err = nrf_modem_at_scanf(
		"AT%XMONITOR",
		"%%XMONITOR: "
		"%*d"                                  /* <reg_status>: ignored */
		",%*[^,]"                              /* <full_name>: ignored */
		",%*[^,]"                              /* <short_name>: ignored */
		",%"STRINGIFY(PLMN_STR_MAX_LEN)"[^,]", /* <plmn> */
		plmn_str);
	if (err != 1) {
		LOG_WRN("Couldn't read PLMN from modem, location assistance unavailable");
		return;
	}

	/* NULL terminate MCC and read it. */
	plmn_str[4] = '\0';
	mcc = strtol(plmn_str + 1, NULL, 10);

	mcc_info = mcc_lookup(mcc);
	if (mcc_info == NULL) {
		LOG_WRN("No location found for MCC %u", mcc);
		return;
	}

	location.latitude = lat_convert(mcc_info->lat);
	location.longitude = lon_convert(mcc_info->lon);
	location.unc_semimajor = mcc_info->unc_semimajor;
	location.unc_semiminor = mcc_info->unc_semiminor;
	location.orientation_major = mcc_info->orientation;
	location.confidence = mcc_info->confidence;

#if defined(CONFIG_SAU_LOW_ACCURACY)
	if (CONFIG_SAU_ASSISTANCE_REFERENCE_ALT != -32767) {
		/* Use reference altitude to enable 3-sat first fix. */
		LOG_INF("Using reference altitude %d meters",
			CONFIG_SAU_ASSISTANCE_REFERENCE_ALT);
		location.altitude = CONFIG_SAU_ASSISTANCE_REFERENCE_ALT;
		/* The altitude uncertainty has to be less than 100 meters (coded number K has to
		 * be less than 48) for the altitude to be used for a 3-sat fix. GNSS increases
		 * the uncertainty depending on the age of the altitude and whether the device is
		 * stationary or moving. The uncertainty is set to 0 (meaning 0 meters), so that
		 * it remains usable for a 3-sat fix for as long as possible.
		 */
		location.unc_altitude = 0;
	} else
#endif
	{
		location.unc_altitude = 255; /* altitude not used */
	}

	err = nrf_modem_gnss_agps_write(&location, sizeof(location), NRF_MODEM_GNSS_AGPS_LOCATION);
	if (err) {
		LOG_ERR("Failed to inject location for MCC %u, error %d", mcc, err);
		return;
	}

	LOG_INF("Injected location for MCC %u", mcc);
}

int assistance_init(struct k_work_q *assistance_work_q)
{
	ARG_UNUSED(assistance_work_q);

	int err;

	err = settings_subsys_init();
	if (err) {
		LOG_ERR("Settings subsystem initialization failed, error %d", err);
		return err;
	}

	err = settings_register(&assistance_settings);
	if (err) {
		LOG_ERR("Registering settings handler failed, error %d", err);
		return err;
	}

	err = settings_load();
	if (err) {
		LOG_ERR("Loading settings failed, error %d", err);
		return err;
	}

	factory_almanac_write();

	return 0;
}

int assistance_request(struct nrf_modem_gnss_agps_data_frame *agps_request)
{
	if (agps_request->data_flags & NRF_MODEM_GNSS_AGPS_SYS_TIME_AND_SV_TOW_REQUEST) {
		time_inject();
	}

	if (agps_request->data_flags & NRF_MODEM_GNSS_AGPS_POSITION_REQUEST) {
		location_inject();
	}

	return 0;
}

bool assistance_is_active(void)
{
	/* Always return false because assistance_request() doesn't take much time. */
	return false;
}
```

## src/assistance_supl.c
```c
/*
 * Copyright (c) 2019 Nordic Semiconductor ASA
 *
 * SPDX-License-Identifier: LicenseRef-Nordic-5-Clause
 */

#include <stdio.h>
#include <zephyr.h>
#include <logging/log.h>
#include <net/socket.h>
#include <supl_os_client.h>
#include <supl_session.h>

#include "assistance.h"

LOG_MODULE_DECLARE(SAU, CONFIG_SAU_LOG_LEVEL);

#define SUPL_SERVER        CONFIG_SAU_SUPL_HOSTNAME
#define SUPL_SERVER_PORT   CONFIG_SAU_SUPL_PORT

BUILD_ASSERT(sizeof(CONFIG_SAU_SUPL_HOSTNAME) > 1, "Server hostname must be configured");

static int supl_fd = -1;
static volatile bool assistance_active;

static ssize_t supl_read(void *p_buff, size_t nbytes, void *user_data)
{
	ARG_UNUSED(user_data);

	ssize_t rc = recv(supl_fd, p_buff, nbytes, 0);

	if (rc < 0 && (errno == ETIMEDOUT)) {
		return 0;
	}

	return rc;
}

static ssize_t supl_write(const void *p_buff, size_t nbytes, void *user_data)
{
	ARG_UNUSED(user_data);

	return send(supl_fd, p_buff, nbytes, 0);
}

static int inject_agps_type(void *agps, size_t agps_size, uint16_t type, void *user_data)
{
	ARG_UNUSED(user_data);

	int retval = nrf_modem_gnss_agps_write(agps, agps_size, type);

	if (retval != 0) {
		LOG_ERR("Failed to write A-GPS data, type: %d (errno: %d)", type, errno);
		return -1;
	}

	LOG_INF("Injected A-GPS data, type: %d, size: %d", type, agps_size);

	return 0;
}

static int supl_logger(int level, const char *fmt, ...)
{
	char buffer[256] = { 0 };
	va_list args;

	va_start(args, fmt);
	int ret = vsnprintk(buffer, sizeof(buffer), fmt, args);

	va_end(args);

	if (ret < 0) {
		LOG_ERR("%s: encoding error", __func__);
		return ret;
	} else if ((size_t)ret >= sizeof(buffer)) {
		LOG_ERR("%s: too long message,"
		       "it will be cut short", __func__);
	}

	LOG_INF("%s", buffer);

	return ret;
}

static int open_supl_socket(void)
{
	int err;
	char port[6];
	struct addrinfo *info;

	struct addrinfo hints = {
		.ai_flags = AI_NUMERICSERV,
		.ai_family = AF_UNSPEC, /* Both IPv4 and IPv6 addresses accepted. */
		.ai_socktype = SOCK_STREAM
	};

	snprintf(port, sizeof(port), "%d", SUPL_SERVER_PORT);

	err = getaddrinfo(SUPL_SERVER, port, &hints, &info);
	if (err) {
		LOG_ERR("Failed to resolve hostname %s, error: %d", SUPL_SERVER, err);

		return -1;
	}

	/* Not connected. */
	err = -1;

	for (struct addrinfo *addr = info; addr != NULL; addr = addr->ai_next) {
		char ip[INET6_ADDRSTRLEN] = { 0 };
		struct sockaddr *const sa = addr->ai_addr;

		supl_fd = socket(sa->sa_family, SOCK_STREAM, IPPROTO_TCP);
		if (supl_fd < 0) {
			LOG_ERR("Failed to create socket, errno %d", errno);
			goto cleanup;
		}

		/* The SUPL library expects a 1 second timeout for the read function. */
		struct timeval timeout = {
			.tv_sec = 1,
			.tv_usec = 0,
		};

		err = setsockopt(supl_fd, SOL_SOCKET, SO_RCVTIMEO, &timeout, sizeof(timeout));
		if (err) {
			LOG_ERR("Failed to set socket timeout, errno %d", errno);
			goto cleanup;
		}

		inet_ntop(sa->sa_family,
			  (void *)&((struct sockaddr_in *)sa)->sin_addr,
			  ip,
			  INET6_ADDRSTRLEN);
		LOG_INF("Connecting to %s port %d", ip, SUPL_SERVER_PORT);

		err = connect(supl_fd, sa, addr->ai_addrlen);
		if (err) {
			close(supl_fd);
			supl_fd = -1;

			/* Try the next address. */
			LOG_WRN("Connecting to server failed, errno %d", errno);
		} else {
			/* Connected. */
			break;
		}
	}

cleanup:
	freeaddrinfo(info);

	if (err) {
		/* Unable to connect, close socket. */
		LOG_ERR("Could not connect to SUPL server");
		if (supl_fd > -1) {
			close(supl_fd);
			supl_fd = -1;
		}
		return -1;
	}

	return 0;
}

static void close_supl_socket(void)
{
	if (close(supl_fd) < 0) {
		LOG_ERR("Failed to close SUPL socket");
	}
}

int assistance_init(struct k_work_q *assistance_work_q)
{
	ARG_UNUSED(assistance_work_q);

	static struct supl_api supl_api = {
		.read       = supl_read,
		.write      = supl_write,
		.handler    = inject_agps_type,
		.logger     = supl_logger,
		.counter_ms = k_uptime_get
	};

	if (supl_init(&supl_api) != 0) {
		LOG_ERR("Failed to initialize SUPL library");
		return -1;
	}

	return 0;
}

int assistance_request(struct nrf_modem_gnss_agps_data_frame *agps_request)
{
	int err;

	assistance_active = true;

	err = open_supl_socket();
	if (err) {
		goto exit;
	}

	LOG_INF("Starting SUPL session");
	err = supl_session(agps_request);
	LOG_INF("Done");
	close_supl_socket();

exit:
	assistance_active = false;

	return err;
}

bool assistance_is_active(void)
{
	return assistance_active;
}
```

## src/haavard.c
```c
#include <string.h>
#include <zephyr.h>


void GoodTooKnow() {
    printk("Jeg bæsjer vær dag, sånn ca.");
}
```

## src/mcc_location_table.h
```c
/*
 * Copyright (c) 2021 Nordic Semiconductor ASA
 *
 * SPDX-License-Identifier: LicenseRef-Nordic-5-Clause
 */

#ifndef MCC_LOCATION_TABLE_H_
#define MCC_LOCATION_TABLE_H_

struct __attribute__ ((__packed__)) mcc_table {
	uint8_t confidence;    /* percentage, 0-100 */
	uint8_t unc_semiminor; /* scaled, see GNSS interface for details */
	uint8_t unc_semimajor; /* scaled, see GNSS interface for details */
	uint8_t orientation;   /* orientation angle between the major axis and north */
	float lat;
	float lon;
	uint16_t mcc;
};

/**
 * @brief Finds location information for a given Mobile Country Code (MCC).
 *
 * @param mcc[in] MCC to look for.
 *
 * @return Location information for the matching MCC, NULL if no entry was found.
 */
const struct mcc_table *mcc_lookup(uint16_t mcc);

/**
 * @brief Converts a latitude in degrees to the integer representation used by GNSS.
 *
 * @param lat[in] Latitude in degrees.
 *
 * @return Latitude in scaled integer representation.
 */
int32_t lat_convert(float lat);

/**
 * @brief Converts a longitude in degrees to the integer representation used by GNSS.
 *
 * @param lon[in] Longitude in degrees.
 *
 * @return Longitude in scaled integer representation.
 */
int32_t lon_convert(float lon);

#endif /* MCC_LOCATION_TABLE_H_ */
```
